## sw/meta-asicsagh/conf/distro/asicsagh-poky-tiny.conf
```bitbake
require conf/distro/poky-tiny.conf
require include/asicsagh.inc

DISTRO = "asicsagh-poky-tiny"
DISTRO_NAME = "asicsagh linux (asicsagh-poky-tiny)"
```

## sw/meta-asicsagh/conf/distro/asicsagh-poky.conf
```bitbake
require conf/distro/poky.conf
require include/asicsagh.inc

DISTRO = "asicsagh-poky"
DISTRO_NAME = "asicsagh linux (asicsagh-poky)"
```

## sw/meta-asicsagh/conf/distro/include/asicsagh.inc
```bitbake
DISTRO_VERSION_MAJOR ?= "1"
DISTRO_VERSION_MINOR ?= "0"
DISTRO_VERSION_PATCH ?= "0"
DISTRO_VERSION = "${DISTRO_VERSION_MAJOR}.${DISTRO_VERSION_MINOR}.${DISTRO_VERSION_PATCH}"

DISTRO_FEATURES:append = " \
    systemd \
    usrmerge \
"
DISTRO_FEATURES_BACKFILL_CONSIDERED:append = " \
    sysvinit \
"

PREFERRED_PROVIDER_virtual/kernel = "linux-socfpga-lts"
PREFERRED_VERSION_linux-socfpga-lts = "6.1%"

PREFERRED_PROVIDER_virtual/bootloader = "u-boot-socfpga"
PREFERRED_VERSION_u-boot-socfpga = "v2023.04%"

VIRTUAL-RUNTIME_init_manager = "systemd"
VIRTUAL-RUNTIME_initscripts = "systemd-compat-units"
VIRTUAL-RUNTIME_login_manager = "shadow-base"
VIRTUAL-RUNTIME_dev_manager = "systemd"
```

## sw/meta-asicsagh/conf/layer.conf
```bitbake
BBPATH .= ":${LAYERDIR}"
BBFILES:append = " ${LAYERDIR}/recipes*/*/*.bb ${LAYERDIR}/recipes*/*/*.bbappend "
BBFILE_COLLECTIONS:append = " meta-asicsagh "
BBFILE_PATTERN_meta-asicsagh := "^${LAYERDIR}/"
BBFILES_PRIORITY_meta-asicsagh = "7"
LAYERSERIES_COMPAT_meta-asicsagh = "master walnascar"
BBDEBUG = "yes"
```

## sw/meta-asicsagh/conf/machine/de0-nano-soc.conf
```bitbake
require conf/machine/cyclone5.conf

KERNEL_DEVICETREE = "socfpga_cyclone5_de0_nano_soc.dtb"
UBOOT_CONFIG = "de0-nano-soc"

IMAGE_BOOT_FILES:append := " \
    de0_nano_soc.rbf \
    u-boot.scr \
"
```
